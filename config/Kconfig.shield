## config/Kconfig.shield
```kconfig
# Copyright (c) 2020 Ryan Cross
# SPDX-License-Identifier: MIT

config SHIELD_SOFLE2_LEFT
	def_bool $(shields_list_contains,sofle2_left)

config SHIELD_SOFLE2_RIGHT
	def_bool $(shields_list_contains,sofle2_right)
```
